## components/esp_svc_disc/Kconfig
```kconfig
menu "ESP Service Discovery Configuration"

    config ESP_SVC_DISC_MAX_HOSTNAME_LEN
        int "Maximum hostname length"
        range 16 64
        default 32
        help
            Maximum length for hostnames in service discovery.

    config ESP_SVC_DISC_MAX_SERVICE_NAME_LEN
        int "Maximum service name length"
        range 16 128
        default 64
        help
            Maximum length for service names.

    config ESP_SVC_DISC_DISCOVERY_TIMEOUT_MS
        int "Default discovery timeout (ms)"
        range 1000 30000
        default 5000
        help
            Default timeout for service discovery operations.

    config ESP_SVC_DISC_TASK_STACK_SIZE
        int "Discovery task stack size"
        range 2048 8192
        default 4096
        help
            Stack size for the service discovery task.

    config ESP_SVC_DISC_TASK_PRIORITY
        int "Discovery task priority"
        range 1 25
        default 5
        help
            Priority for the service discovery task.

    config ESP_SVC_DISC_ENABLE_DEBUG
        bool "Enable debug logging"
        default n
        help
            Enable detailed debug logging for service discovery operations.

endmenu
```

## example/sdkconfig.defaults
```kconfig
# Ethernet Configuration for QEMU
CONFIG_ETH_USE_ESP32_EMAC=y
CONFIG_ETH_PHY_INTERFACE_RMII=y
CONFIG_ETH_RMII_CLK_INPUT=y
CONFIG_ETH_RMII_CLK_IN_GPIO=0
CONFIG_ETH_PHY_RTL8201=y
CONFIG_ETH_PHY_ADDR=1
CONFIG_ETH_PHY_RST_GPIO=-1
CONFIG_ETH_USE_OPENETH=y

# mDNS Configuration
CONFIG_MDNS_MAX_SERVICES=10
CONFIG_MDNS_TASK_PRIORITY=1
CONFIG_MDNS_TASK_STACK_SIZE=4096
CONFIG_MDNS_TASK_AFFINITY_CPU0=y
CONFIG_MDNS_SERVICE_ADD_TIMEOUT_MS=2000
CONFIG_MDNS_STRICT_MODE=y
CONFIG_MDNS_ENABLE_DEBUG=y

# FreeRTOS Configuration
CONFIG_FREERTOS_HZ=1000

# ESP System Configuration
CONFIG_ESP_MAIN_TASK_STACK_SIZE=8192

# Log Configuration
CONFIG_LOG_DEFAULT_LEVEL_INFO=y

# Network Configuration
CONFIG_LWIP_IPV6=n

# QEMU specific configurations
CONFIG_ESP32_XTAL_FREQ_40=y
CONFIG_ESP32_XTAL_FREQ=40
```
